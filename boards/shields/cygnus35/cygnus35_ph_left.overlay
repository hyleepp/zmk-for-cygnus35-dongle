/*
 * Copyright (c) 2025 Noir Guo
 *
 * SPDX-License-Identifier: MIT
 */

#include "cygnus35.dtsi"

/ {
    chosen {
        zmk,kscan = &kscan0;
    };

    kscan0: kscan {
        compatible = "zmk,kscan-gpio-matrix";
        diode-direction = "row2col";
        wakeup-source;

       row-gpios
            = <&gpio1 0 GPIO_ACTIVE_HIGH>
            , <&gpio0 11 GPIO_ACTIVE_HIGH>
            , <&gpio1 04  GPIO_ACTIVE_HIGH>
            , <&gpio1 06 GPIO_ACTIVE_HIGH>
            ;

        col-gpios
            = <&gpio0 31 (GPIO_ACTIVE_HIGH | GPIO_PULL_DOWN)>
            , <&gpio0 29  (GPIO_ACTIVE_HIGH | GPIO_PULL_DOWN)>
            , <&gpio0 2 (GPIO_ACTIVE_HIGH | GPIO_PULL_DOWN)>
            , <&gpio1 15 (GPIO_ACTIVE_HIGH | GPIO_PULL_DOWN)>
            , <&gpio1 13  (GPIO_ACTIVE_HIGH | GPIO_PULL_DOWN)>
            ;
    };
};
